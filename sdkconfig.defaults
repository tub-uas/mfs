## sdkconfig.defaults
```kconfig
CONFIG_FREERTOS_HZ=1000

# CONFIG_ESP_CONSOLE_UART_DEFAULT=
# CONFIG_ESP_CONSOLE_UART_CUSTOM=y
# CONFIG_ESP_CONSOLE_UART_NONE=
# CONFIG_ESP_CONSOLE_UART_CUSTOM_NUM_0=
# CONFIG_ESP_CONSOLE_UART_CUSTOM_NUM_1=y
# CONFIG_ESP_CONSOLE_UART_NUM=1
# CONFIG_ESP_CONSOLE_UART_TX_GPIO=1
# CONFIG_ESP_CONSOLE_UART_RX_GPIO=3
# CONFIG_ESP_CONSOLE_UART_BAUDRATE=115200
```
